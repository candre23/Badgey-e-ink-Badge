/*
  Heltec Vision Master E290 (HT-VME290) - E-Badge (Framebuffer over BLE + Serial)
  - Wake key: USER_KEY = GPIO21 (EXT0 wake on LOW)
  - User LED: GPIO45 blinks 500ms on/off while awake
  - Awake/connectable for 5 minutes OR until an update is received
  - Updates can come from:
      * BLE framebuffer characteristic (preferred)
      * BLE text characteristic (kept for debug/back-compat)
      * Serial newline text (debug)
  - After update: refresh e-ink, then deep sleep
*/

#include <Arduino.h>
#include "heltec-eink-modules.h"   // heltec-eink-modules (todd-herbert)
#include <NimBLEDevice.h>          // NimBLE-Arduino / esp-nimble-cpp wrapper

// --------- Pins ----------
static const gpio_num_t WAKE_BTN = GPIO_NUM_21; // USER_KEY verified as GPIO21
static const int USER_LED_PIN = 45;             // user LED per schematic
// -------------------------

static const uint32_t AWAKE_WINDOW_MS = 5UL * 60UL * 1000UL;

// Display size (Vision Master E290)
static const uint16_t BADGE_W = 128;
static const uint16_t BADGE_H = 296;
static const uint16_t FB_BYTES = (BADGE_W * BADGE_H) / 8; // 4736

// BLE UUIDs
static const char* BLE_DEVICE_NAME = "E-Badge";
static const char* SERVICE_UUID    = "6a3a7b52-2d6d-4a2b-8d1a-0d4d6c3a1c10";
static const char* CHAR_TEXT_UUID  = "c2b6b0b5-0d18-4d9a-8f2c-6a3b90a0b8a1";
// New framebuffer characteristic UUID (matches Android app)
static const char* CHAR_FB_UUID    = "f3a7e19c-5f21-4c3c-8b64-3c2f6fd1c4ab";

EInkDisplay_VisionMasterE290 display;

static bool wokeFromButton() {
  return esp_sleep_get_wakeup_cause() == ESP_SLEEP_WAKEUP_EXT0;
}

// Serial line buffer
static String g_serialLine;

// Update flags/state
static volatile bool g_updateReady = false;
static bool g_haveFramebuffer = false;
static String g_latestText;

// Framebuffer RX state
static uint8_t g_fb[FB_BYTES];
static bool g_fbReceiving = false;
static uint16_t g_fbExpected = FB_BYTES;
static uint16_t g_fbOffset = 0;

// ---------- Boot logo (Badgey) ----------
// https://javl.github.io/image2cpp/
// 128x296, bg color white, invert image colors, binary dither, arduino code single bitmap, 
// prefix epd_bitmap_, draw mode horizontal 1 bit per pixel
static const uint16_t LOGO_W = 128;
static const uint16_t LOGO_H = 296;

const unsigned char badgey_boot_logo[] PROGMEM = {
	0x00, 0x00, 0x00, 0x00, 0x00, 0x00, 0x00, 0x00, 0x00, 0x00, 0x00, 0x00, 0x00, 0x00, 0x00, 0x00, 
	0x00, 0x00, 0x00, 0x00, 0x00, 0x00, 0x00, 0x00, 0x00, 0x00, 0x00, 0x00, 0x00, 0x00, 0x00, 0x00, 
	0x00, 0x00, 0x00, 0x00, 0x00, 0x00, 0x00, 0x00, 0x00, 0x00, 0x00, 0x00, 0x00, 0x00, 0x00, 0x00, 
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	0x00, 0x00, 0x00, 0x00, 0x00, 0x00, 0x00, 0x00, 0x00, 0x00, 0x00, 0x00, 0x00, 0x00, 0x00, 0x00
};

// Draw logo centered on current rotation/coordinate system.
static void drawBootLogo() {
display.fillScreen(WHITE);
display.drawBitmap(0, 0, badgey_boot_logo, LOGO_W, LOGO_H, BLACK);
display.update();
}

// -------- Display helpers --------
static void drawCenteredText(const String& s, uint8_t textSize) {
  display.fillScreen(WHITE);
  display.setTextColor(BLACK);
  display.setTextSize(textSize);

  int16_t x1, y1;
  uint16_t w, h;
  display.getTextBounds(s, 0, 0, &x1, &y1, &w, &h);

  int16_t x = (display.width()  - (int16_t)w) / 2;
  int16_t y = (display.height() - (int16_t)h) / 2;
  if (x < 0) x = 0;
  if (y < 0) y = 0;

  display.setCursor(x, y);
  display.print(s);
  display.update();
}

static void drawFramebufferToDisplay(const uint8_t* packed, uint16_t w, uint16_t h) {
  display.fillScreen(WHITE);
  display.drawBitmap(0, 0, packed, w, h, BLACK);
  display.update();
}


// -------- Power / sleep --------
static void goToDeepSleep() {
  Serial.println("[sleep] Turning off LED and entering deep sleep...");

  digitalWrite(USER_LED_PIN, LOW);
  pinMode(USER_LED_PIN, INPUT); // best-effort to reduce leakage

  esp_sleep_enable_ext0_wakeup(WAKE_BTN, 0); // wake on LOW
  delay(50);
  esp_deep_sleep_start();
}

// -------- BLE callbacks --------
class TextCallbacks : public NimBLECharacteristicCallbacks {
  void onWrite(NimBLECharacteristic* pCharacteristic, NimBLEConnInfo& connInfo) override {
    (void)connInfo;

    std::string v = pCharacteristic->getValue();
    if (v.empty()) return;

    if (v.size() > 200) v.resize(200);
    g_latestText = String(v.c_str());
    g_haveFramebuffer = false;
    g_updateReady = true;

    Serial.print("[ble:text] Received text: ");
    Serial.println(g_latestText);
  }
};

// Parse little-endian u16 from a byte pointer
static uint16_t u16le(const uint8_t* p) {
  return (uint16_t)p[0] | ((uint16_t)p[1] << 8);
}

class FramebufferCallbacks : public NimBLECharacteristicCallbacks {
  void onWrite(NimBLECharacteristic* pCharacteristic, NimBLEConnInfo& connInfo) override {
    (void)connInfo;

    const std::string v = pCharacteristic->getValue();
    if (v.empty()) return;

    const uint8_t* data = (const uint8_t*)v.data();
    size_t len = v.size();
    Serial.print("[ble:fb] onWrite len=");
    Serial.println((int)len);


    // Helper to consume bytes from this packet
    auto consume = [&](size_t n) {
      data += n;
      len  -= n;
    };


    // If we're not currently receiving, the packet should begin with a header.
    // But be tolerant: header+payload may come in same write.
    if (!g_fbReceiving) {
      // Accept either:
      //   A) "EBG1" + w(u16) + h(u16) + payloadLen(u16)  (10 bytes total)
      //   B) "FB"   + payloadLen(u16)                   (4 bytes total)
      uint16_t w = BADGE_W;
      uint16_t h = BADGE_H;
      uint16_t payloadLen = 0;
      size_t headerLen = 0;

      if (len >= 10 && data[0] == 'E' && data[1] == 'B' && data[2] == 'G' && data[3] == '1') {
        w = u16le(data + 4);
        h = u16le(data + 6);
        payloadLen = u16le(data + 8);
        headerLen = 10;

        Serial.print("[ble:fb] Header EBG1 w=");
        Serial.print(w);
        Serial.print(" h=");
        Serial.print(h);
        Serial.print(" len=");
        Serial.println(payloadLen);
        Serial.print("[ble:fb] onWrite len=");
        Serial.println((int)len);
      }
      else if (len >= 4 && data[0] == 'F' && data[1] == 'B') {
        payloadLen = u16le(data + 2);
        headerLen = 4;

        Serial.print("[ble:fb] Header FB len=");
        Serial.println(payloadLen);
      }
      else {
        Serial.println("[ble:fb] No valid header found; ignoring packet.");
        return;
      }

      if (w != BADGE_W || h != BADGE_H) {
        Serial.println("[ble:fb] Unexpected dimensions; ignoring transfer.");
        return;
      }
      if (payloadLen != FB_BYTES) {
        Serial.println("[ble:fb] Unexpected payload length; ignoring transfer.");
        return;
      }

      // Start receiving
      g_fbReceiving = true;
      g_fbExpected = payloadLen;
      g_fbOffset = 0;

      consume(headerLen);
    }


    // Copy remaining bytes into framebuffer
    if (g_fbReceiving && len > 0) {
      size_t toCopy = len;
      if (g_fbOffset + toCopy > g_fbExpected) {
        toCopy = g_fbExpected - g_fbOffset;
      }

      if (toCopy > 0) {
        memcpy(g_fb + g_fbOffset, data, toCopy);
        g_fbOffset += (uint16_t)toCopy;
      }

      // Progress logging (only at 512-byte boundaries BEFORE completion)
      if (g_fbOffset < g_fbExpected && (g_fbOffset % 512) == 0) {
        Serial.print("[ble:fb] Progress ");
        Serial.print(g_fbOffset);
        Serial.print("/");
        Serial.println(g_fbExpected);
      }

      // Completion
      if (g_fbOffset >= g_fbExpected) {
        Serial.print("[ble:fb] Frame complete: ");
        Serial.print(g_fbOffset);
        Serial.print("/");
        Serial.println(g_fbExpected);

        g_haveFramebuffer = true;
        g_updateReady = true;
        g_fbReceiving = false;
      }

    }
  }
};

static NimBLEAdvertising* g_adv = nullptr;

static void startBLE() {
  Serial.println("[ble] Initializing BLE...");

  NimBLEDevice::init(BLE_DEVICE_NAME);
  NimBLEDevice::setPower(ESP_PWR_LVL_P9); // MAX power for visibility

  NimBLEServer* server = NimBLEDevice::createServer();
  NimBLEService* svc = server->createService(SERVICE_UUID);

  NimBLECharacteristic* chrText = svc->createCharacteristic(
    CHAR_TEXT_UUID,
    NIMBLE_PROPERTY::WRITE | NIMBLE_PROPERTY::WRITE_NR
  );
  chrText->setCallbacks(new TextCallbacks());

  NimBLECharacteristic* chrFb = svc->createCharacteristic(
    CHAR_FB_UUID,
    NIMBLE_PROPERTY::WRITE | NIMBLE_PROPERTY::WRITE_NR
  );
  chrFb->setCallbacks(new FramebufferCallbacks());

  svc->start();

  g_adv = NimBLEDevice::getAdvertising();
  g_adv->stop();  // safety

  NimBLEAdvertisementData adv;
  adv.setFlags(0x06); // LE General Discoverable, BR/EDR not supported
  adv.setName(BLE_DEVICE_NAME);
  adv.addServiceUUID(NimBLEUUID(SERVICE_UUID));

  NimBLEAdvertisementData scanResp;
  scanResp.setName(BLE_DEVICE_NAME);

  g_adv->setAdvertisementData(adv);
  g_adv->setScanResponseData(scanResp);
  g_adv->setMinInterval(0x20); // fast advertising
  g_adv->setMaxInterval(0x40);

  bool ok = g_adv->start();
  Serial.print("[ble] Advertising start returned: ");
  Serial.println(ok ? "true" : "false");
}


static void stopBLE() {
  Serial.println("[ble] Stopping BLE...");
  if (g_adv) g_adv->stop();
  NimBLEDevice::deinit(true);
  Serial.println("[ble] BLE stopped.");
}

// -------- Serial input handling --------
// Reads newline-terminated text. When a full line arrives, treat as an update.
static void pollSerialForLine() {
  while (Serial.available() > 0) {
    char c = (char)Serial.read();
    if (c == '\r') continue;

    if (c == '\n') {
      g_serialLine.trim();
      if (g_serialLine.length() > 0) {
        if (g_serialLine.length() > 200) {
          g_serialLine = g_serialLine.substring(0, 200);
        }
        g_latestText = g_serialLine;
        g_haveFramebuffer = false;
        g_updateReady = true;

        Serial.print("[serial] Received line: ");
        Serial.println(g_latestText);
      }
      g_serialLine = "";
      return;
    }

    if (g_serialLine.length() < 300) {
      g_serialLine += c;
    }
  }
}

void setup() {
  Serial.begin(115200);
  delay(300);
  Serial.println();
  Serial.println("[boot] E-Badge starting...");

  pinMode((int)WAKE_BTN, INPUT_PULLUP);

  pinMode(USER_LED_PIN, OUTPUT);
  digitalWrite(USER_LED_PIN, LOW);

  display.setRotation(2);
  Serial.print("[display] width=");
  Serial.print(display.width());
  Serial.print(" height=");
  Serial.println(display.height());
  
// If we woke via the user button (EXT0), do NOT redraw the e-ink.
if (wokeFromButton()) {
  Serial.println("[boot] Wake from button; leaving display unchanged.");
} else {
  Serial.println("[boot] Cold boot; drawing boot logo.");
  drawBootLogo();
}

  // Reset RX state
  g_fbReceiving = false;
  g_fbOffset = 0;
  g_updateReady = false;
  g_haveFramebuffer = false;

  startBLE();

  Serial.println("[boot] Ready. Send framebuffer via BLE or text via Serial/BLE.");
}

void loop() {
  static uint32_t startMs = millis();
  static uint32_t lastBlinkMs = 0;
  static bool ledOn = false;

 static uint32_t lastLog = 0;
 if (millis() - lastLog > 2000) {
   lastLog = millis();
   Serial.println("[loop] alive");
 }

  // Blink user LED while awake/connectable: 500ms on/off
  uint32_t now = millis();
  if (now - lastBlinkMs >= 500) {
    lastBlinkMs = now;
    ledOn = !ledOn;
    digitalWrite(USER_LED_PIN, ledOn ? HIGH : LOW);
  }

  pollSerialForLine();

  // If update received, apply it and sleep
  if (g_updateReady) {
    Serial.println("[update] Applying update to display...");
    stopBLE();

    if (g_haveFramebuffer) {
      drawFramebufferToDisplay(g_fb, BADGE_W, BADGE_H);
    } else {
      drawCenteredText(g_latestText, 2);
    }
    Serial.println("[update] Display update done.");
    goToDeepSleep();
  }

  // Timeout -> sleep
  if (millis() - startMs >= AWAKE_WINDOW_MS) {
    Serial.println("[timeout] No update received in 5 minutes.");
    stopBLE();
    goToDeepSleep();
  }

  delay(10);
}
